## components/ddns/Kconfig
```kconfig
menu "DDNS Dynamic DNS"

    config DDNS_ENABLED
        bool "DDNS support"
        default n
        help
            Enable Dynamic DNS client for automatic WAN IP registration
            with NoIP, DuckDNS, or Selfhost.de. All three providers are
            compiled; selection is at runtime via web/CLI.

    config DDNS_POLL_INTERVAL
        int "Keep-alive interval in seconds (compile-time default)"
        range 3600 604800
        default 86400
        depends on DDNS_ENABLED
        help
            Compile-time fallback for the keep-alive interval. The web UI and
            CLI expose this in hours (1-168); this value is always in seconds.
            Default 86400 (24 h) satisfies NoIP's 30-day keepalive requirement.

    config DDNS_SAVE_INTERVAL
        int "Save config to NVS interval in seconds"
        range 60 3600
        default 3600
        depends on DDNS_ENABLED
        help
            Periodically persist DDNS config to NVS (prevents loss on crash).

endmenu
```

## components/pcap_capture/Kconfig
```kconfig
menu "PCAP Capture"

    config PCAP_CAPTURE
        bool "Enable PCAP packet capture"
        default n
        help
            Enable live packet capture streamed over TCP (port 19000)
            to Wireshark or tcpdump.  Adds a TCP server task, a ring
            buffer (~16-32 KB RAM depending on target), and the 'pcap'
            CLI command.  Also enables allow_monitor / deny_monitor ACL
            actions and the PCAP section on the config web page.

            Disable to save flash and RAM on constrained targets.

endmenu
```

## main/Kconfig.projbuild
```kconfig
menu "Example Configuration"

    config STORE_HISTORY
        bool "Store command history in flash"
        default y
        help
            Linenoise line editing library provides functions to save and load
            command history. If this option is enabled, initalizes a FAT filesystem
            and uses it to store command history.

endmenu

menu "NAT Router Uplink"

    choice UPLINK_TYPE
        prompt "Uplink interface"
        default WIFI_STA_UPLINK
        config WIFI_STA_UPLINK
            bool "WiFi STA"
        config ETH_UPLINK
            bool "Ethernet"
    endchoice

    choice ETH_DRIVER_TYPE
        prompt "Ethernet driver"
        default ETH_DRIVER_EMAC
        depends on ETH_UPLINK
        config ETH_DRIVER_EMAC
            bool "Internal EMAC (LAN8720)"
        config ETH_DRIVER_W5500
            bool "SPI Ethernet W5500"
    endchoice

    # --- Internal EMAC options (WT32-ETH01) ---
    config ETH_MDC_GPIO
        int "ETH MDC GPIO"
        default 23
        depends on ETH_UPLINK && ETH_DRIVER_EMAC

    config ETH_MDIO_GPIO
        int "ETH MDIO GPIO"
        default 18
        depends on ETH_UPLINK && ETH_DRIVER_EMAC

    config ETH_PHY_ADDR
        int "ETH PHY address"
        default 1
        depends on ETH_UPLINK && ETH_DRIVER_EMAC

    config ETH_PHY_POWER_GPIO
        int "ETH PHY power GPIO (-1 for none)"
        default 16
        depends on ETH_UPLINK && ETH_DRIVER_EMAC

    # --- W5500 SPI Ethernet options ---
    config ETH_SPI_HOST
        int "W5500 SPI host"
        default 1
        depends on ETH_UPLINK && ETH_DRIVER_W5500

    config ETH_SPI_MISO_GPIO
        int "W5500 MISO GPIO"
        default 5
        depends on ETH_UPLINK && ETH_DRIVER_W5500

    config ETH_SPI_MOSI_GPIO
        int "W5500 MOSI GPIO"
        default 6
        depends on ETH_UPLINK && ETH_DRIVER_W5500

    config ETH_SPI_SCLK_GPIO
        int "W5500 SCLK GPIO"
        default 4
        depends on ETH_UPLINK && ETH_DRIVER_W5500

    config ETH_SPI_CS_GPIO
        int "W5500 CS GPIO"
        default 7
        depends on ETH_UPLINK && ETH_DRIVER_W5500

    config ETH_SPI_INT_GPIO
        int "W5500 INT GPIO"
        default 3
        depends on ETH_UPLINK && ETH_DRIVER_W5500

    config ETH_SPI_RST_GPIO
        int "W5500 RST GPIO (-1 to disable)"
        default 2
        depends on ETH_UPLINK && ETH_DRIVER_W5500

    config ETH_SPI_CLOCK_MHZ
        int "W5500 SPI clock (MHz)"
        default 27
        range 1 80
        depends on ETH_UPLINK && ETH_DRIVER_W5500

endmenu

menu "MQTT Home Assistant"

    config MQTT_HOMEASSISTANT
        bool "Enable MQTT Home Assistant integration"
        default y
        help
            Publishes router telemetry to an MQTT broker with
            Home Assistant auto-discovery. Adds ~58 KB flash.
            RAM is only used when a broker is configured and enabled.

    config MQTT_HA_BUFFER_SIZE
        int "MQTT buffer size (bytes)"
        default 1024
        depends on MQTT_HOMEASSISTANT

    config MQTT_DEFAULT_INTERVAL
        int "Default publish interval (seconds)"
        default 30
        depends on MQTT_HOMEASSISTANT
         range 5 3600

endmenu

source "../components/ddns/Kconfig"
```
